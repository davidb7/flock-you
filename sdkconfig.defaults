## sdkconfig.defaults
```kconfig
# Seeed XIAO ESP32-S3 default configuration for Flock-You

# USB CDC as the console/serial port (replaces Arduino's Serial)
CONFIG_ESP_CONSOLE_USB_CDC=y
CONFIG_ESP_CONSOLE_SECONDARY_NONE=y

# Bluetooth / NimBLE
CONFIG_BT_ENABLED=y
CONFIG_BT_NIMBLE_ENABLED=y
CONFIG_BT_NIMBLE_MAX_CONNECTIONS=3
CONFIG_BT_NIMBLE_ROLE_OBSERVER=y
CONFIG_BT_NIMBLE_ROLE_PERIPHERAL=y
CONFIG_BT_NIMBLE_NVS_PERSIST=n

# WiFi — SoftAP support required
CONFIG_ESP_WIFI_SOFTAP_SUPPORT=y

# SPIFFS
CONFIG_SPIFFS_MAX_PARTITIONS=1

# Custom partition table (6 MB app + ~2 MB SPIFFS)
CONFIG_PARTITION_TABLE_CUSTOM=y
CONFIG_PARTITION_TABLE_CUSTOM_FILENAME="partitions.csv"

# PSRAM (OPI mode for ESP32-S3 on XIAO)
CONFIG_SPIRAM=y
CONFIG_SPIRAM_MODE_OCT=y
CONFIG_SPIRAM_SPEED_80M=y
CONFIG_SPIRAM_BOOT_INIT=y

# Flash
CONFIG_ESPTOOLPY_FLASHSIZE_8MB=y
CONFIG_ESPTOOLPY_FLASHMODE_QIO=y
CONFIG_ESPTOOLPY_FLASHFREQ_80M=y

# CPU frequency
CONFIG_ESP32S3_DEFAULT_CPU_FREQ_240=y

# Main task stack
CONFIG_ESP_MAIN_TASK_STACK_SIZE=8192

# FreeRTOS tick rate (1ms resolution for millis() accuracy)
CONFIG_FREERTOS_HZ=1000

# Newlib (for printf, fopen, etc.)
CONFIG_NEWLIB_STDOUT_LINE_ENDING_CRLF=n
```
